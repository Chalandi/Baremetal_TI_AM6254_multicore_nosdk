;--------------------------------------------------------------------------------
; Close the debug session log file
;--------------------------------------------------------------------------------

SYStem.RESet
LOG.CLOSE
AREA.CLEAR

;--------------------------------------------------------------------------------
; Handle trace32 events
;--------------------------------------------------------------------------------
ON ERROR CONTinue

;--------------------------------------------------------------------------------
; Configure the debug interfate (Cpu, Jtag, Dap, GIC, ...)
;--------------------------------------------------------------------------------
SYStem.CPU AM625X-CR5
SYStem.CONFIG CORE  5. 1.
&dp=0x40000364

SYStem.JTAGCLOCK CTCK 25MHz
SYStem.MemAccess.DAP
SYStem.Option.imaskasm.on
SYStem.Option.IMASKHLL.ON

SYStem.Mode Prepare
Data.Set EDBG:&dp %Long 0yxxxxxxxxxxxxxx0000xxxxxxxxxxxxxx



;--------------------------------------------------------------------------------
; Enable breakpoints in all CPU modes
;--------------------------------------------------------------------------------
SYStem.Option.ZoneSPACES ON ; Enable symbol management
Break.CONFIG.MatchZone ON ; Enable bp match in different zones
Break.IMPL Program Onchip
Break.IMPL Read Onchip
Break.IMPL Write Onchip
SYStem.Option BreakOS ON

;--------------------------------------------------------------------------------
; Load only the symbols from the ELF file
;--------------------------------------------------------------------------------
;Data.LOAD.Elf D:\Git_Repo\Baremetal_RPi3A+_quad_core\Output\baremetal_RPi3A+_quad_core.elf /NoCODE /NoRegister

;--------------------------------------------------------------------------------
; Set source path
;--------------------------------------------------------------------------------
;sYmbol.SourcePATH.SetBaseDir "\\wsl.localhost\Ubuntu-22.04\home\achalandi\Workspace"


;--------------------------------------------------------------------------------
; Create custom buttons in the toolbar
;--------------------------------------------------------------------------------
MENU.ReProgram
(
  ADD
  TOOLBAR
  (
    TOOLITEM "Go to PC" "[:here]"
    (
      Break
      List Register(pc) /Track /MarkPC
    )

    TOOLITEM "Reset the target" "Reset,R"
    (
      ; SW Reset
      SYStem.Mode Prepare
      WAIT 1s
      SYStem.Mode Attach

    )

    TOOLITEM "Edit startup script" "[:edit]"
    (
      PEDIT config_Cortex-R5.cmm
    )

    TOOLITEM "Run startup script" "[:practice]"
    (
      DO config_Cortex-R5.cmm
      Data.LOAD.Elf ..\Output\r5f_baremetal_am6254_nosdk.elf /NoCODE /NoRegister
      ENDDO
    )

  )
)

;--------------------------------------------------------------------------------
; Attach to the running CPU and halt
;--------------------------------------------------------------------------------
SYStem.Mode Attach
Break

;--------------------------------------------------------------------------------
; List the source code and the registers values
;--------------------------------------------------------------------------------
List Register(pc) /Track /MarkPC
Register.view /SpotLight

;--------------------------------------------------------------------------------
; Re-enable all active breakpoints
;--------------------------------------------------------------------------------
Break.DISable /ALL
Break.ENable /ALL

;--------------------------------------------------------------------------------
; Create the debug session log file
;--------------------------------------------------------------------------------
LOG.ON
LOG.OPEN config.log

;--------------------------------------------------------------------------------
; Load window layout
;--------------------------------------------------------------------------------
DO WinLayout.cmm

;--------------------------------------------------------------------------------
; Load only the symbols from the ELF file
;--------------------------------------------------------------------------------
Data.LOAD.Elf ..\Output\r5f_baremetal_am6254_nosdk.elf /NoCODE /NoRegister