// T32_1000008 Fri May 16 12:10:27 2025

B::

TOOLBAR   ON
STATUSBAR ON
FramePOS 3.7143,2.1667,,,Maximized
WinPAGE.RESet

WinPAGE.Create P000
WinCLEAR

WinPOS 74.0 0.75 185. 6. 42. 1. W003
WinTABS 13. 0. 0. 0. 0. 0. 0. 0. 0. 115.
Break.List

WinPOS 74.429 14.417 185. 46. 24. 1. W001
WinTABS 10. 10. 25.
List Register(pc) /Track /MarkPC

WinPOS 0.14286 26.25 68. 41. 0. 0. W002
Register.view /SpotLight

WinPOS 0.28571 7.25 61. 14. 0. 1. W000
WinTABS 20. 15. 26.
TargetSystem.state

WinPOS 0.71429 0.33333 36. 3. 0. 0. W005
core.SHOWACTIVE

WinPAGE.select P000

ENDDO
