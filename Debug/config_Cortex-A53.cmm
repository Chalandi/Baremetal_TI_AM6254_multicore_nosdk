;--------------------------------------------------------------------------------
; Close the debug session log file
;--------------------------------------------------------------------------------
SYStem.RESet
LOG.CLOSE
AREA.CLEAR

setup.PDFViewer.EXEcutable "C:\Program Files (x86)\Adobe\Reader 11.0\Reader\AcroRd32.exe"
setup.PDFViewer.OPEN.DOCument "%1"
setup.PDFViewer.OPEN.NamedDest /A "nameddest=%3" "%1"
setup.PDFViewer.PRinT "%2"
;--------------------------------------------------------------------------------
; Handle trace32 events
;--------------------------------------------------------------------------------
ON ERROR CONTinue

;--------------------------------------------------------------------------------
; Configure the debug interfate (Cpu, Jtag, Dap, GIC, ...)
;--------------------------------------------------------------------------------
SYStem.CPU AM625X
SYStem.MemAccess DAP
SYStem.CpuBreak Enable
SYStem.CpuSpot Enable
SYStem.JtagClock 10MHz
SYStem.Option.IMASKASM ON
SYStem.Option.EnReset OFF
SYStem.Option.TRST ON

SYStem.CONFIG.DAPDRPOST 0.
SYStem.CONFIG.DAPDRPRE 0.
SYStem.CONFIG.DAPIRPOST 0.
SYStem.CONFIG.DAPIRPRE 0.

SYStem.CONFIG.DEBUGAP1.Port 1.
SYStem.CONFIG.AXIAP1.Port 2.
SYStem.CONFIG.JTAGAP1.Port 5.
SYStem.CONFIG.MEMORYAP1.Port 7.

sys.config.cn 4.
CORE.ASSIGN 1. 2. 3. 4.

SYStem.CONFIG.COREDEBUG.Base DAP:0x90010000 DAP:0x90110000 DAP:0x90210000 DAP:0x90310000 DAP:0x9d410000
SYStem.CONFIG.CTI.Base       DAP:0x90020000 DAP:0x90120000 DAP:0x90220000 DAP:0x90320000 DAP:0x9d418000


;--------------------------------------------------------------------------------
; Enable breakpoints in all CPU modes
;--------------------------------------------------------------------------------
SYStem.Option.ZoneSPACES ON ; Enable symbol management
Break.CONFIG.MatchZone ON ; Enable bp match in different zones
Break.IMPL Program Onchip
Break.IMPL Read Onchip
Break.IMPL Write Onchip
SYStem.Option BreakOS ON
SETUP.IMASKASM OFF
SETUP.IMASKHLL OFF

;--------------------------------------------------------------------------------
; Load only the symbols from the ELF file
;--------------------------------------------------------------------------------
Data.LOAD.Elf ..\Output\a53_baremetal_am6254_nosdk.elf /NoCODE /NoRegister


-----------------------------------------------------------------------------
; Set source path
;--------------------------------------------------------------------------------
;sYmbol.SourcePATH.SetBaseDir "\\wsl.localhost\Ubuntu-22.04\home\achalandi\Workspace"

SYStem.Option.CoreSightRESet ON
;--------------------------------------------------------------------------------
; Create custom buttons in the toolbar
;--------------------------------------------------------------------------------
MENU.ReProgram
(
  ADD
  TOOLBAR
  (
    TOOLITEM "Go to PC" "[:here]"
    (
      Break
      List Register(pc) /Track /MarkPC
    )

    TOOLITEM "Reset the target" "Reset,R"
    (
      ; SW Reset
      SYStem.Mode Prepare
      WAIT 1s
      SYStem.Mode Attach

    )

    TOOLITEM "Edit startup script" "[:edit]"
    (
      PEDIT config_Cortex-A53.cmm
    )

    TOOLITEM "Run startup script" "[:practice]"
    (
      DO config_Cortex-A53.cmm
      ;Data.LOAD.Elf D:\Git_Repo\Baremetal_RPi3A+_quad_core\Output\baremetal_RPi3A+_quad_core.elf /NoCODE /NoRegister
      ENDDO
    )

  )
)

;--------------------------------------------------------------------------------
; Attach to the running CPU and halt
;--------------------------------------------------------------------------------
SYStem.Mode Attach
Break

;--------------------------------------------------------------------------------
; List the source code and the registers values
;--------------------------------------------------------------------------------
List Register(pc) /Track /MarkPC
Register.view /SpotLight

;--------------------------------------------------------------------------------
; Re-enable all active breakpoints
;--------------------------------------------------------------------------------
Break.DISable /ALL
Break.ENable /ALL

;--------------------------------------------------------------------------------
; Create the debug session log file
;--------------------------------------------------------------------------------
LOG.ON
LOG.OPEN config.log

;--------------------------------------------------------------------------------
; Load window layout
;--------------------------------------------------------------------------------
DO WinLayout.cmm
;--------------------------------------------------------------------------------
; Load only the symbols from the ELF file
;--------------------------------------------------------------------------------
Data.LOAD.Elf ..\Output\a53_baremetal_am6254_nosdk.elf /NoCODE /NoRegister